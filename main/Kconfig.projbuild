## main/Kconfig.projbuild
```kconfig
menu "Example Configuration"

    config ESP_WIFI_SSID
        string "WiFi SSID"
        default "Redmi_B3D4_5G"
        help
            SSID (network name) for the example to connect to.

    config ESP_WIFI_PASSWORD
        string "WiFi Password"
        default "88888888"
        help
            WiFi password (WPA or WPA2) for the example to use.

    choice ESP_WIFI_SAE_MODE
        prompt "WPA3 SAE mode selection"
        default ESP_STATION_EXAMPLE_WPA3_SAE_PWE_BOTH
        help
            Select mode for SAE as Hunt and Peck, H2E or both.
        config ESP_STATION_EXAMPLE_WPA3_SAE_PWE_HUNT_AND_PECK
            bool "HUNT AND PECK"
        config ESP_STATION_EXAMPLE_WPA3_SAE_PWE_HASH_TO_ELEMENT
            bool "H2E"
            depends on ESP_WIFI_ENABLE_SAE_H2E
        config ESP_STATION_EXAMPLE_WPA3_SAE_PWE_BOTH
            bool "BOTH"
            depends on ESP_WIFI_ENABLE_SAE_H2E
    endchoice

    config ESP_WIFI_PW_ID
        string "PASSWORD IDENTIFIER"
        depends on  ESP_STATION_EXAMPLE_WPA3_SAE_PWE_HASH_TO_ELEMENT|| ESP_STATION_EXAMPLE_WPA3_SAE_PWE_BOTH
        default ""
        help
            password identifier for SAE H2E

    config ESP_MAXIMUM_RETRY
        int "Maximum retry"
        default 5
        help
            Set the Maximum retry to avoid station reconnecting to the AP unlimited when the AP is really inexistent.

    choice ESP_WIFI_SCAN_AUTH_MODE_THRESHOLD
        prompt "WiFi Scan auth mode threshold"
        default ESP_WIFI_AUTH_WPA2_PSK
        help
            The weakest authmode to accept in the scan mode.
            This value defaults to ESP_WIFI_AUTH_WPA2_PSK in case password is present and ESP_WIFI_AUTH_OPEN is used.
            Please select ESP_WIFI_AUTH_WEP/ESP_WIFI_AUTH_WPA_PSK in case AP is operating in WEP/WPA mode.

        config ESP_WIFI_AUTH_OPEN
            bool "OPEN"
        config ESP_WIFI_AUTH_WEP
            bool "WEP"
        config ESP_WIFI_AUTH_WPA_PSK
            bool "WPA PSK"
        config ESP_WIFI_AUTH_WPA2_PSK
            bool "WPA2 PSK"
        config ESP_WIFI_AUTH_WPA_WPA2_PSK
            bool "WPA/WPA2 PSK"
        config ESP_WIFI_AUTH_WPA3_PSK
            bool "WPA3 PSK"
        config ESP_WIFI_AUTH_WPA2_WPA3_PSK
            bool "WPA2/WPA3 PSK"
        config ESP_WIFI_AUTH_WAPI_PSK
            bool "WAPI PSK"
    endchoice

    config VOLC_AUDIO_SELFTEST
        bool "启动时运行音频自测（喇叭提示音 + 麦克风峰峰值）"
        default n
        help
            打开后，设备在连接 Wi-Fi 之前先阻塞约 7 秒：
            先向喇叭输出一段提示音（测试 LEDC PWM 喇叭接线），
            再采集麦克风并打印 ADC 峰峰值（测试麦克风接线）。
            仅用于排查麦克风/喇叭硬件问题，确认正常后请关闭。

    menu "OneNET MQTT Configuration"

        config ONENET_MQTT_URI
            string "OneNET MQTT broker URI"
            default "mqtt://mqtts.heclouds.com:1883"
            help
                OneNET MQTT 服务器地址。普通 MQTT 使用 mqtt://mqtts.heclouds.com:1883。

        config ONENET_PRODUCT_ID
            string "OneNET Product ID"
            default "your_product_id"
            help
                OneNET 产品 ID。请在 menuconfig 中改成你的真实产品 ID。

        config ONENET_DEVICE_NAME
            string "OneNET Device Name"
            default "esp32c5_bme690"
            help
                OneNET 设备名称。请在 menuconfig 中改成你的真实设备名称。

        config ONENET_DEVICE_TOKEN
            string "OneNET Device Secret or Full Token"
            default "your_device_secret_or_token"
            help
                OneNET 设备密钥或完整 token。
                推荐填写 OneNET 控制台设备详情里的设备密钥，程序会自动生成 MQTT password token。
                如果你已经手动生成完整 token，也可以直接填写以 version= 开头的完整 token。

        config ONENET_TOKEN_EXPIRE_TIMESTAMP
            int "OneNET token expire timestamp"
            default 1893456000
            help
                OneNET token 过期时间戳，单位秒。默认 1893456000 约等于 2030-01-01。
                只有当 ONENET_DEVICE_TOKEN 填写设备密钥时才会使用；如果填写完整 token，则忽略此项。

        config ONENET_PROPERTY_POST_INTERVAL_SECONDS
            int "Property post interval seconds"
            default 10
            range 3 3600
            help
                MQTT 属性上报周期，单位秒。

    endmenu

    menu "BME690 I2C Configuration"

        config BME690_I2C_SDA_GPIO
            int "BME690 I2C SDA GPIO"
            default 2
            range 0 28
            help
                BME690 的 SDA 接到 ESP32-C5 的有效数字 GPIO。ESP32-SensairShuttle 的 Shuttle Board Connector 默认 SDA=GPIO2。

        config BME690_I2C_SCL_GPIO
            int "BME690 I2C SCL GPIO"
            default 3
            range 0 28
            help
                BME690 的 SCL 接到 ESP32-C5 的有效数字 GPIO。ESP32-SensairShuttle 的 Shuttle Board Connector 默认 SCL=GPIO3。

        config BME690_I2C_FREQ_HZ
            int "BME690 I2C clock frequency"
            default 100000
            help
                I2C 时钟频率，默认 100kHz，适合大多数 BME690 模块。

    endmenu

endmenu
```

## sdkconfig.defaults
```kconfig
CONFIG_ESP_WIFI_SOFTAP_SUPPORT=n

# 优化固件体积
CONFIG_COMPILER_OPTIMIZATION_SIZE=y

# ===== 硬件规格：ESP32-C5-WROOM-1-N16R8 (16MB Flash + 8MB PSRAM) =====
# Flash 大小设为 16MB
CONFIG_ESPTOOLPY_FLASHSIZE_16MB=y
CONFIG_ESPTOOLPY_FLASHSIZE="16MB"

# 启用 PSRAM（8MB），供音频缓冲、RTC SDK 大块内存使用
CONFIG_SPIRAM=y
CONFIG_SPIRAM_MODE_QUAD=y
CONFIG_SPIRAM_SPEED_80M=y
# 允许 malloc 在内部 RAM 不足时回退到 PSRAM
CONFIG_SPIRAM_USE_MALLOC=y
# 大于该阈值的分配优先走 PSRAM，保护内部 RAM
CONFIG_SPIRAM_MALLOC_ALWAYSINTERNAL=16384
CONFIG_SPIRAM_TRY_ALLOCATE_WIFI_LWIP=y

# ===== 分区表：使用自定义大 app 分区，容纳 RTC 静态库 =====
CONFIG_PARTITION_TABLE_CUSTOM=y
CONFIG_PARTITION_TABLE_CUSTOM_FILENAME="partitions.csv"
CONFIG_PARTITION_TABLE_FILENAME="partitions.csv"

# ===== Wi-Fi 默认连接配置 =====
CONFIG_ESP_WIFI_SSID="Redmi_B3D4_5G"
CONFIG_ESP_WIFI_PASSWORD="88888888"

# ===== OneNET MQTT 凭证（控制台获取） =====
CONFIG_ONENET_PRODUCT_ID="Kt5Z8Eph6q"
CONFIG_ONENET_DEVICE_NAME="zhixin_001"
CONFIG_ONENET_DEVICE_TOKEN="YXIwRUR2a1dnUEdvd21NczJVTHZRaGU3TkRVTGNaajc="
```
